/*************************
 * Customized Battery Setting dtsi file
*************************/
&bat_comm {
	/* cust_charging.h */
	/* stop charging while in talking mode */
	stop_charging_in_takling = <1>;
	talking_recharge_voltage = <3800>;
	talking_sync_time = <60>;

	/* Battery Temperature Protection */
	mtk_temperature_recharge_support = <1>;
	max_charge_temperature = <50>;
	max_charge_temperature_minus_x_degree = <47>;
	min_charge_temperature = <0>;
	min_charge_temperature_plus_x_degree = <6>;
	err_charge_temperature = <0xff>;

	/* Linear Charging Threshold */
	v_pre2cc_thres = <3400>;	/* unit: mV */
	v_cc2topoff_thres = <4050>;
	recharging_voltage = <4110>;
	charging_full_current = <100>;	/* unit: mA */

	/* Charging Current Setting */
	config_usb_if = <0>;
	usb_charger_current_suspend = <0>;	/* Unit: 0.01 mA */
	usb_charger_current_unconfigured = <7000>;	/* Unit: 0.01 mA */
	usb_charger_current_configured = <50000>;	/* Unit: 0.01 mA */
	usb_charger_current = <50000>;	/* Unit: 0.01 mA */
	ac_charger_input_current = <150000 >;/*<200000 >;*/ /* Unit: 0.01 mA @chenlijun 20170224 200000 */
	ac_charger_current = <120000>;/*<200000>;*/	/* Unit: 0.01 mA */
	non_std_ac_charger_current = <50000>;	/* Unit: 0.01 mA */
	charging_host_charger_current = <65000>;	/* Unit: 0.01 mA */
	apple_0_5a_charger_current = <50000>;	/* Unit: 0.01 mA */
	apple_1_0a_charger_current = <65000>;	/* Unit: 0.01 mA */
	apple_2_1a_charger_current = <80000>;	/* Unit: 0.01 mA */

	/* charger error check */
	bat_low_temp_protect_enable = <0>;
	v_charger_enable = <0>;	/* 1:on , 0:off */
	v_charger_max = <6500>;	/* unit: mV */
	v_charger_min = <4400>;

	/*  Tracking TIME */
	onehundred_percent_tracking_time = <10>;	/* Unit: second */
	npercent_tracking_time = <20>;	/* Unit: second */
	sync_to_real_tracking_time = <60>;	/* Unit: second */
	v_0percent_tracking = <3500>;	/* Unit: mV */

	/* High battery support */
	high_battery_voltage_support = <0>;
};

&bat_meter {
	/* cust_battery_meter.h */
	/* ADC resistor  */
	r_bat_sense = <4>;
	r_i_sense = <4>;
	r_charger_1 = <330>;
	r_charger_2 = <39>;
	temperature_t0 = <110>;
	temperature_t1 = <0>;
	temperature_t2 = <25>;
	temperature_t3 = <50>;
	temperature_t = <255>;	/* this should be fixed, never change the value */
	fg_meter_resistance = <0>;

	
	/* Qmax for 0mA */
	/*
	q_max_pos_50 = <2669>;
	q_max_pos_25 = <2715>;
	q_max_pos_0 = <2712>;
	q_max_neg_10 = <2683>;
	*/
	/* Qmax for 600mA, said high current */
	/*
	q_max_pos_50_h_current = <2639>;
	q_max_pos_25_h_current = <2686>;
	q_max_pos_0_h_current = <2589>;
	q_max_neg_10_h_current = <2337>;
	*/
	
	/* Qmax for 0mA */
	q_max_pos_50 = <2500>;
	q_max_pos_25 = <2550>;
	q_max_pos_0 = <2550>;
	q_max_neg_10 = <2500>;
	/* Qmax for 600mA, said high current */
	q_max_pos_50_h_current = <2500>;
	q_max_pos_25_h_current = <2550>;
	q_max_pos_0_h_current = <2500>;
	q_max_neg_10_h_current = <2400>;	
	
	/* Discharge percentage, 1: D5, 0: D2 */
	oam_d5 = <0>;/*<1>;*/

	change_tracking_point = <1>;
	/* SW OCV tracking setting */
	cust_tracking_point = <14>;
	cust_r_sense = <200>;
	cust_hw_cc = <0>;
	aging_tuning_value = <100>;
	cust_r_fg_offset = <0>;
	ocv_board_compesate = <0>;
	r_fg_board_base = <1000>;
	r_fg_board_slope = <1000>;
	car_tune_value = <89>;

	/* HW Fuel gague  */
	current_detect_r_fg = <10>;	/* Unit: mA */
	minerroroffset = <1000>;
	fg_vbat_average_size = <18>;
	r_fg_value = <10>;	/* Unit: mOhm */

	cust_poweron_delta_capacity_tolrance = <80>;
	cust_poweron_low_capacity_tolrance = <2>;
	cust_poweron_max_vbat_tolrance = <70>;
	cust_poweron_delta_vbat_tolrance = <60>;
	cust_poweron_delta_hw_sw_ocv_capacity_tolrance = <10>;

	/* Fixed battery temperature */
	fixed_tbat_25 = <0>;
	/* Dynamic change wake up period of battery thread when suspend */
	vbat_normal_wakeup = <3600>;	/* Unit: mV */
	vbat_low_power_wakeup = <3500>;	/* Unit: mV */
	normal_wakeup_period = <5400>;	/* Unit: second */
	low_power_wakeup_period = <300>;	/* Unit: second */
	close_poweroff_wakeup_period = <30>;	/* Unit: second */

	rbat_pull_up_r = <16900>;
	rbat_pull_up_volt = <1800>;

	batt_temperature_table_num = <17>;
	batt_temperature_table = <
        (-20) 70654
        (-15) 55337
        (-10) 43662
        (-5)  34696
         0 27760
         5 22358
        10 18121
        15 14778
        20 12122
        25 10000
        30 8295 
        35 6916 
        40 5796 
        45 4881
        50 4130
        55 3510 
        60 2997>;
			batt_temperature_table_tcl = <
	(-20) 74354
        (-15) 57626
        (-10) 45068
        (-5)  35548
         0 28267
         5 22650
        10 18280
        15 14855
        20 12150
        25 10000
        30 8279 
        35 6892 
        40 5768 
        45 4852
        50 4101
        55 3482 
        60 2970>;

	battery_profile_t0_num = <94>;
	battery_profile_t0 = <
0   4169
1   4152
2   4136
3   4115
4   4094
5   4082
6   4071
7   4056
9   4039
10  4022
11  4008
12  3997
13  3987
14  3979
15  3973
16  3967
17  3961
18  3957
19  3953
20  3950
21  3944
22  3939
24  3933
25  3927
26  3921
27  3914
28  3906
29  3899
30  3891
31  3885
32  3876
33  3870
34  3863
35  3857
36  3850
37  3845
38  3841
40  3835
41  3831
42  3827
43  3823
44  3819
45  3816
46  3813
47  3809
48  3806
49  3803
50  3801
51  3798
52  3795
53  3793
54  3790
56  3788
57  3787
58  3785
59  3782
60  3781
61  3780
62  3779
63  3778
64  3777
65  3775
67  3773
69  3770
71  3767
72  3765
73  3763
74  3761
75  3758
76  3753
78  3749
79  3746
80  3743
81  3738
82  3734
83  3731
84  3725
85  3720
87  3715
88  3710
89  3707
90  3704
91  3702
92  3697
93  3694
94  3687
95  3676
96  3657
97  3628
98  3589
99  3539
100 3472
100 3374
100 3154

>;
battery_profile_t0_tcl = <
0   4190 
1   4173 
2   4159 
3   4150 
4   4140 
5   4130 
6   4120 
7   4113 
8   4096 
9   4086 
10  4078 
11  4070 
12  4061 
13  4052 
14  4043 
15  4034 
16  4027 
17  4019 
18  4010 
19  4002 
20  3993 
21  3986 
22  3979 
23  3961 
24  3955 
25  3947 
26  3939 
27  3932 
28  3924 
29  3919 
30  3912 
31  3905 
32  3899 
33  3893 
35  3882 
36  3876 
37  3867 
38  3861 
39  3856 
40  3852 
41  3847 
43  3840 
44  3834 
45  3831 
46  3827 
47  3823 
48  3819 
49  3815 
50  3814 
51  3806 
52  3803 
53  3799 
54  3797 
55  3794 
56  3792 
58  3787 
59  3784 
60  3781 
61  3779 
64  3772 
65  3771 
66  3766 
67  3765 
68  3762 
69  3761 
70  3759 
71  3756 
72  3755 
74  3749 
75  3747 
76  3744 
77  3740 
78  3738 
79  3735 
80  3726 
81  3721 
82  3716 
84  3708 
85  3702 
86  3698 
87  3695 
88  3691 
89  3687 
90  3682 
91  3679 
92  3675 
93  3669 
94  3660 
95  3628 
96  3600 
97  3566 
98  3527 
99  3505 
100 3500
>;

	battery_profile_t1_num = <94>;
	battery_profile_t1 = <
0    4169
1    4152
2    4140
3    4129
4    4119
5    4110
6    4102
7    4097
8    4092
10   4076
12   4050
13   4035
15   4012
17   3995
18   3989
19   3983
20   3979
22   3970
24   3961
25   3956
26   3951
27   3946
28   3940
29   3934
30   3928
31   3923
32   3916
33   3910
34   3903
35   3895
36   3887
37   3879
38   3872
39   3865
40   3858
41   3852
42   3847
43   3843
44   3838
45   3834
46   3831
47   3827
48   3823
49   3821
50   3817
51   3814
52   3812
53   3809
54   3807
55   3805
57   3800
58   3798
59   3797
60   3795
62   3792
64   3790
65   3789
66   3788
67   3788
68   3786
69   3785
70   3784
71   3783
72   3781
73   3779
75   3774
76   3772
77   3768
78   3766
79   3763
80   3760
81   3757
82   3753
83   3749
84   3744
85   3740
86   3736
87   3731
88   3725
89   3718
90   3712
91   3709
92   3707
93   3705
94   3703
95   3699
96   3693
97   3674
98   3639
99   3594
100  3536
100  3459
100  3344
100  3146

>;
		battery_profile_t1_tcl = <
0   4200 
1   4185 
2   4171 
3   4161 
4   4151 
5   4141 
6   4131 
7   4115 
8   4106 
9   4099 
10  4090 
11  4081 
12  4072 
13  4064 
14  4056 
15  4048 
16  4040 
17  4031 
18  4025 
19  4017 
20  4001 
21  3996 
22  3988 
23  3981 
24  3974 
25  3966 
26  3959 
27  3953 
28  3946 
29  3938 
30  3933 
31  3926 
32  3911 
33  3905 
34  3899 
35  3891 
36  3886 
37  3880 
38  3874 
39  3868 
40  3863 
41  3857 
42  3852 
43  3848 
44  3838 
45  3833 
46  3829 
47  3826 
48  3822 
49  3817 
50  3814 
51  3811 
52  3807 
53  3805 
54  3802 
55  3798 
56  3795 
57  3791 
59  3786 
60  3785 
61  3782 
62  3779 
65  3775 
66  3772 
67  3770 
69  3765 
71  3763 
72  3760 
73  3758 
75  3753 
77  3748 
78  3744 
79  3742 
80  3738 
81  3733 
82  3724 
83  3717 
84  3712 
85  3706 
86  3699 
87  3694 
88  3688 
89  3684 
90  3680 
91  3678 
92  3674 
93  3669 
94  3658 
95  3642 
96  3615 
97  3578 
98  3532 
99  3505 
100 3500
>;

	battery_profile_t2_num = <94>;
	battery_profile_t2 = <
0     4186
1     4169
2     4159
4     4140
6     4121
8     4104
9     4095
10    4087
11    4073
13    4060
14    4050
15    4038
16    4027
17    4017
18    4008
19    4001
20    3994
21    3988
24    3972
25    3966
27    3955
28    3949
29    3943
30    3938
31    3932
32    3921
33    3915
34    3909
35    3903
36    3897
38    3883
39    3874
40    3865
41    3857
42    3850
43    3844
44    3839
45    3834
46    3830
47    3825
48    3822
49    3818
50    3815
51    3811
52    3809
53    3803
54    3800
55    3798
56    3795
57    3793
58    3791
59    3789
60    3787
61    3785
62    3783
63    3782
64    3780
65    3779
66    3777
67    3776
68    3775
69    3774
70    3772
71    3770
72    3766
73    3760
74    3757
75    3754
76    3750
77    3747
79    3742
80    3739
81    3736
82    3733
83    3729
84    3725
85    3720
86    3716
87    3712
88    3707
89    3701
90    3693
91    3690
93    3687
94    3682
95    3678
96    3666
97    3637
98    3599
99    3550
100   3486
100   3400
100   3258
100   3153

>;
	battery_profile_t2_tcl = <
0   4197 
1   4184 
2   4173 
3   4162 
4   4151 
5   4141 
6   4134 
7   4114 
8   4105 
9   4097 
10  4089 
11  4080 
12  4072 
13  4062 
14  4056 
15  4047 
16  4039 
17  4033 
18  4026 
19  4011 
20  4003 
21  3997 
22  3991 
23  3983 
24  3978 
25  3972 
26  3963 
27  3959 
28  3953 
29  3948 
30  3942 
31  3930 
32  3925 
33  3919 
34  3913 
35  3908 
36  3902 
37  3897 
38  3890 
39  3884 
40  3879 
41  3873 
42  3864 
43  3859 
45  3842 
46  3837 
47  3833 
48  3828 
49  3823 
51  3815 
52  3813 
53  3809 
54  3806 
55  3802 
56  3797 
57  3795 
58  3791 
60  3786 
61  3783 
62  3781 
63  3780 
64  3778 
65  3776 
67  3770 
68  3769 
69  3766 
71  3764 
73  3760 
74  3758 
76  3752 
77  3746 
78  3742 
79  3737 
80  3729 
81  3726 
82  3721 
83  3716 
84  3711 
85  3706 
86  3700 
87  3693 
88  3685 
89  3678 
90  3674 
91  3671 
92  3652 
93  3649 
94  3645 
95  3646 
96  3625 
97  3589 
98  3544 
99  3505 
100 3500
>;

	battery_profile_t3_num = <94>;
	battery_profile_t3 = <
0   4179
1   4165
2   4151
3   4142
4   4133
5   4123
6   4112
7   4103
8   4094
9   4085
10  4067
11  4058
13  4041
14  4033
15  4026
16  4016
17  4008
19  3995
20  3985
21  3978
23  3964
25  3950
26  3943
28  3931
29  3923
31  3911
32  3900
33  3894
34  3889
35  3881
36  3877
37  3871
38  3864
39  3860
40  3852
41  3841
42  3833
43  3824
44  3816
45  3810
46  3805
47  3801
48  3798
49  3793
50  3787
51  3782
52  3779
53  3776
54  3772
55  3770
56  3768
57  3765
58  3764
59  3761
60  3759
61  3757
62  3754
64  3751
65  3748
67  3745
68  3743
69  3740
70  3737
71  3733
72  3728
73  3722
74  3719
75  3712
76  3709
77  3706
78  3703
79  3700
80  3697
81  3695
82  3692
83  3689
84  3686
85  3680
87  3672
88  3667
89  3658
90  3650
91  3646
93  3643
95  3640
96  3633
97  3621
98  3590
99  3551
100 3503
100 3441
100 3358
100 3227
100 3178
>;
      battery_profile_t3_tcl = <
0   4194
1   4181
2   4170
3   4160
4   4149
5   4138
6   4128
7   4121
8   4111
9   4093
10  4086
11  4077
12  4069
13  4060
14  4052
15  4045
16  4036
17  4030
18  4022
19  4015
20  4007
21  4000
22  3990
23  3986
24  3973
25  3966
27  3954
28  3948
29  3942
30  3938
31  3929
33  3919
34  3914
35  3909
36  3903
37  3900
38  3895
39  3888
40  3878
41  3871
42  3862
43  3854
44  3849
45  3841
46  3835
47  3831
48  3828
49  3822
50  3817
51  3814
53  3807
54  3806
55  3799
56  3794
58  3790
59  3787
60  3785
61  3782
63  3777
64  3774
65  3776
66  3772
67  3769
69  3767
70  3764
71  3755
72  3749
73  3745
74  3739
75  3737
76  3733
77  3729
78  3725
79  3720
80  3716
81  3713
82  3709
84  3699
85  3694
86  3682
87  3673
88  3664
89  3660
90  3658
91  3657
92  3653
93  3650
94  3648
95  3640
96  3617
97  3586
98  3545
99  3505 
100 3500
>;

	r_profile_t0_num = <94>;
	r_profile_t0 = <
176     4169
176     4152
181     4136
189     4115
205     4094
219     4082
224     4071
228     4056
230     4039
231     4022
232     4008
234     3997
235     3987
237     3979
237     3973
240     3967
239     3961
241     3957
243     3953
247     3950
228     3944
247     3939
246     3933
248     3927
247     3921
247     3914
245     3906
246     3899
242     3891
240     3885
238     3876
237     3870
237     3863
236     3857
198     3850
231     3845
234     3841
233     3835
233     3831
236     3827
237     3823
236     3819
237     3816
238     3813
238     3809
239     3806
240     3803
240     3801
241     3798
241     3795
242     3793
243     3790
244     3788
246     3787
247     3785
246     3782
247     3781
247     3780
248     3779
249     3778
249     3777
251     3775
253     3773
252     3770
251     3767
254     3765
255     3763
254     3761
255     3758
255     3753
257     3749
258     3746
259     3743
260     3738
259     3734
262     3731
263     3725
263     3720
266     3715
267     3710
273     3707
278     3704
288     3702
295     3697
309     3694
322     3687
340     3676
360     3657
386     3628
427     3589
488     3539
584     3472
595     3374
562     3154
>;
	r_profile_t0_tcl = <
101  4190 
341  4173 
343  4159 
348  4150 
350  4140 
352  4130 
353  4120 
359  4113 
365  4096 
364  4086 
364  4078 
366  4070 
366  4061 
365  4052 
366  4043 
364  4034 
368  4027 
368  4019 
364  4010 
365  4002 
362  3993 
364  3986 
365  3979 
359  3961 
359  3955 
358  3947 
358  3939 
356  3932 
352  3924 
355  3919 
355  3912 
355  3905 
354  3899 
353  3893 
355  3882 
353  3876 
358  3867 
356  3861 
357  3856 
357  3852 
359  3847 
363  3840 
361  3834 
364  3831 
363  3827 
366  3823 
366  3819 
366  3815 
370  3814 
372  3806 
374  3803 
373  3799 
378  3797 
381  3794 
380  3792 
385  3787 
386  3784 
386  3781 
388  3779 
392  3772 
397  3771 
400  3766 
404  3765 
403  3762 
406  3761 
409  3759 
409  3756 
412  3755 
417  3749 
420  3747 
423  3744 
421  3740 
431  3738 
432  3735 
440  3726 
440  3721 
447  3716 
460  3708 
466  3702 
473  3698 
489  3695 
502  3691 
519  3687 
542  3682 
571  3679 
609  3675 
657  3669 
718  3660 
916  3628 
1083 3600 
1298 3566 
1556 3527 
1690 3485 
1732 3395
>;

	r_profile_t1_num = <94>;
	r_profile_t1 = <
122     4169
122     4152
124     4140
124     4129
126     4119
127     4110
128     4102
130     4097
131     4092
131     4076
132     4050
133     4035
133     4012
136     3995
136     3989
137     3983
139     3979
138     3970
143     3961
144     3956
144     3951
146     3946
146     3940
146     3934
147     3928
147     3923
145     3916
144     3910
144     3903
142     3895
139     3887
137     3879
135     3872
134     3865
132     3858
131     3852
129     3847
127     3843
127     3838
126     3834
129     3831
129     3827
128     3823
129     3821
129     3817
130     3814
131     3812
131     3809
128     3807
129     3805
132     3800
133     3798
133     3797
134     3795
134     3792
135     3790
134     3789
134     3788
134     3788
136     3786
136     3785
136     3784
136     3783
136     3781
137     3779
136     3774
134     3772
132     3768
133     3766
136     3763
136     3760
136     3757
136     3753
137     3749
137     3744
138     3740
138     3736
139     3731
138     3725
135     3718
137     3712
139     3709
141     3707
144     3705
150     3703
156     3699
164     3693
165     3674
167     3639
174     3594
193     3536
236     3459
335     3344
394     3146
>;
   r_profile_t1_tcl = <
206   4200 
206   4185 
205   4171 
210   4161 
208   4151 
209   4141 
211   4131 
219   4115 
220   4106 
224   4099 
227   4090 
226   4081 
227   4072 
229   4064 
232   4056 
231   4048 
231   4040 
233   4031 
235   4025 
237   4017 
235   4001 
238   3996 
239   3988 
237   3981 
238   3974 
236   3966 
237   3959 
237   3953 
236   3946 
235   3938 
236   3933 
234   3926 
231   3911 
231   3905 
229   3899 
227   3891 
225   3886 
224   3880 
225   3874 
224   3868 
222   3863 
218   3857 
220   3852 
221   3848 
219   3838 
217   3833 
219   3829 
220   3826 
221   3822 
218   3817 
218   3814 
220   3811 
221   3807 
222   3805 
221   3802 
223   3798 
221   3795 
224   3791 
228   3786 
228   3785 
230   3782 
228   3779 
232   3775 
233   3772 
232   3770 
232   3765 
238   3763 
239   3760 
238   3758 
239   3753 
241   3748 
241   3744 
245   3742 
244   3738 
247   3733 
250   3724 
247   3717 
251   3712 
255   3706 
255   3699 
258   3694 
259   3688 
265   3684 
270   3680 
280   3678 
292   3674 
311   3669 
362   3658 
390   3642 
423   3615 
470   3578 
540   3532 
641   3477 
811   3406
>;

	r_profile_t2_num = <94>;
	r_profile_t2 = <
84  4186
84  4169
85  4159
86  4140
86  4121
87  4104
87  4095
88  4087
89  4073
89  4060
89  4050
88  4038
88  4027
89  4017
89  4008
89  4001
89  3994
89  3988
91  3972
91  3966
92  3955
92  3949
92  3943
93  3938
93  3932
94  3921
96  3915
96  3909
97  3903
98  3897
95  3883
93  3874
91  3865
89  3857
87  3850
88  3844
87  3839
87  3834
86  3830
86  3825
87  3822
87  3818
86  3815
86  3811
87  3809
87  3803
87  3800
87  3798
87  3795
87  3793
87  3791
87  3789
87  3787
88  3785
88  3783
89  3782
89  3780
90  3779
89  3777
90  3776
91  3775
91  3774
90  3772
89  3770
88  3766
87  3760
87  3757
87  3754
87  3750
86  3747
88  3742
87  3739
87  3736
88  3733
87  3729
88  3725
88  3720
88  3716
89  3712
89  3707
89  3701
88  3693
88  3690
90  3687
92  3682
93  3678
92  3666
92  3637
93  3599
96  3550
99  3486
108 3400
132 3258
237 3153
>;
r_profile_t2_tcl = <
109  4197 
109  4184 
111  4173 
110  4162 
107  4151 
106  4141 
111  4134 
106  4114 
108  4105 
109  4097 
112  4089 
110  4080 
110  4072 
109  4062 
110  4056 
111  4047 
112  4039 
116  4033 
114  4026 
115  4011 
114  4003 
117  3997 
118  3991 
117  3983 
121  3978 
121  3972 
119  3963 
122  3959 
124  3953 
126  3948 
128  3942 
127  3930 
130  3925 
129  3919 
129  3913 
130  3908 
132  3902 
129  3897 
127  3890 
126  3884 
127  3879 
126  3873 
124  3864 
123  3859 
117  3842 
117  3837 
116  3833 
115  3828 
113  3823 
111  3815 
112  3813 
111  3809 
110  3806 
110  3802 
112  3797 
113  3795 
110  3791 
110  3786 
110  3783 
109  3781 
113  3780 
113  3778 
113  3776 
114  3770 
114  3769 
113  3766 
113  3764 
115  3760 
115  3758 
115  3752 
112  3746 
111  3742 
111  3737 
113  3729 
116  3726 
115  3721 
117  3716 
116  3711 
119  3706 
119  3700 
117  3693 
116  3685 
114  3678 
114  3674 
116  3671 
146  3652 
169  3649 
174  3645 
196  3646 
133  3625 
133  3589 
134  3544 
142  3491 
150  3423 
>;

	r_profile_t3_num = <94>;
	r_profile_t3 = <
81   4179
81   4165
76   4151
79   4142
81   4133
81   4123
79   4112
81   4103
79   4094
79   4085
81   4067
79   4058
79   4041
81   4033
81   4026
79   4016
79   4008
84   3995
81   3985
79   3978
81   3964
81   3950
81   3943
84   3931
81   3923
81   3911
86   3900
86   3894
86   3889
84   3881
86   3877
86   3871
86   3864
88   3860
88   3852
84   3841
83   3833
81   3824
79   3816
79   3810
79   3805
81   3801
81   3798
81   3793
81   3787
79   3782
79   3779
79   3776
79   3772
76   3770
79   3768
81   3765
81   3764
81   3761
81   3759
84   3757
81   3754
84   3751
81   3748
81   3745
81   3743
83   3740
81   3737
81   3733
81   3728
81   3722
81   3719
79   3712
79   3709
79   3706
79   3703
79   3700
81   3697
81   3695
81   3692
81   3689
81   3686
79   3680
79   3672
79   3667
84   3658
81   3650
79   3646
79   3643
84   3640
86   3633
86   3621
84   3590
86   3551
86   3503
91   3441
98   3358
119  3227
141  3178
>;
	r_profile_t3_tcl = <
96   4194
96   4181
98   4170
97   4160
96   4149
90   4138
90   4128
95   4121
93   4111
91   4093
93   4086
94   4077
94   4069
95   4060
97   4052
100  4045
98   4036
98   4030
98   4022
100  4015
94   4007
98   4000
93   3990
98   3986
98   3973
100  3966
102  3954
102  3948
101  3942
110  3938
103  3929
103  3919
105  3914
106  3909
103  3903
110  3900
109  3895
108  3888
107  3878
106  3871
100  3862
99   3854
106  3849
102  3841
101  3835
101  3831
98   3828
96   3822
95   3817
98   3814
101  3807
104  3806
99   3799
95   3794
102  3790
99   3787
103  3785
103  3782
103  3777
102  3774
111  3776
106  3772
101  3769
105  3767
107  3764
99   3755
100  3749
100  3745
101  3739
102  3737
105  3733
103  3729
103  3725
103  3720
99   3716
101  3713
102  3709
100  3699
102  3694
104  3682
101  3673
100  3664
98   3660
99   3658
107  3657
105  3653
106  3650
108  3648
114  3640
106  3617
105  3586
107  3545
110  3495
115  3437		
>;
};
